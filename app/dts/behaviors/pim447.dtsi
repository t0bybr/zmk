/ {
    behaviors {
        // ... other behaviors ...
        pim447_test: pim447_test {
            compatible = "zmk,behavior-key-press";
            #binding-cells = <0>;
            bindings = <&kp>;
        };
    };
};